#ifndef WATERCLEARVISUAL_H
#define WATERCLEARVISUAL_H

const unsigned char PROGMEM ditherfilter[] = {
0xaa, 0x55, 0xaa, 0x55, 0xaa, 0x55, 0xaa, 0x55, 0xaa, 0x55, 0xaa, 0x55,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 0x55, 
};
const unsigned char PROGMEM waterfall[] = {
0xff, 0x0f, 0x3c, 0xf0, 0xf0, 0x3c, 0x0f, 0xff, 
};
const unsigned char PROGMEM waterwave[] = {
0x04, 0x04, 0x06, 0x03, 0x01, 0x01, 0x02, 0x02, 0x06, 0x07, 0x0f, 0x0f,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 0x0c, 
};
const unsigned char PROGMEM waterwave_big[] = {
0xe0, 0x60, 0xf0, 0x70, 0xb8, 0x7c, 0x3e, 0x5f, 0x2f, 0x57, 0x2f, 0x17,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 0xe0, 
};
const unsigned char PROGMEM eye0[] = {
0x38, 0x04, 0x02, 0x02, 0x74, 
};
const unsigned char PROGMEM eye0_closed[] = {
0x20, 0x40, 0x40, 0x40, 0x40, 
};
const unsigned char PROGMEM signature[] = {
0x00, 0x00, 0x00, 0x00, 0x00, 0x00, 0x00, 0x00, 0x00, 0x00, 0x00, 0x00,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 0x00, 
};
const unsigned char PROGMEM waterdippedfeet[] = {
0x01, 0x01, 0x07, 0x3f, 0xff, 0xff, 0xff, 0xff, 0xf8, 0xc0, 0x00, 0x00, 0x00, 0x80, 0x80, 0xc0, 0xc0, 0xc0, 0x00, 0x00, 
};
const unsigned char PROGMEM waterstageclearmaxvisual_plus_mask[] =
{
// width, height,
56, 64,
// FRAME 00
0x37, 0xff, 0x37, 0xff, 0x37, 0xff, 0x37, 0xff, 0x30, 0xff, 0x37, 0xff,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 0xff, 
0x04, 0xff, 0x08, 0xff, 0x08, 0xff, 0x10, 0xff, 0x60, 0xff, 0x80, 0xff,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 0xff, 
0x00, 0x00, 0x00, 0x00, 0x00, 0x00, 0x00, 0x00, 0x00, 0x00, 0x00, 0x00,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 0xff, 
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0x1c, 0x1c, 0x1c, 0x1c, 0x0c, 0x0c, 0x0e, 0x0e, 0x06, 0x06, 0x06, 0x06,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 0xff,
};
int ditherframe = 0;
int waterfallframe = 0;
int waterwaveframe = 0;
void dither() {
	ditherframe = ditherframe+1;
	arduboy.drawBitmap(ditherframe-2,0,ditherfilter,128,64,WHITE);
  arduboy.drawBitmap(ditherframe,0,ditherfilter,128,64,WHITE);
	if (ditherframe>1) {
		ditherframe = 0;
	}
}
void waterclearvisual_max() {
	waterfallframe = waterfallframe+1;
	waterwaveframe = waterwaveframe+1;
	arduboy.fillRect(0,0,8,40,BLACK);
	arduboy.drawBitmap(0,0+waterfallframe,waterfall,8,8,WHITE);
	arduboy.drawBitmap(0,8+waterfallframe,waterfall,8,8,WHITE);
	arduboy.drawBitmap(0,16+waterfallframe,waterfall,8,8,WHITE); 
	arduboy.drawBitmap(0,24+waterfallframe,waterfall,8,8,WHITE);
	arduboy.drawBitmap(0,32+waterfallframe,waterfall,8,8,WHITE);
	Sprites::drawPlusMask(0, 0, waterstageclearmaxvisual_plus_mask, 0);
	arduboy.fillRect(56,0,72,46,BLACK);
	arduboy.fillRect(53,48,75,2,WHITE);
	arduboy.fillRect(56,53,72,1,BLACK);
	arduboy.fillRect(56,55,72,10,BLACK);
	if (waterfallframe<=1) {
  arduboy.drawBitmap(40,56,waterdippedfeet,18,8,WHITE);
	}
	if (waterfallframe==2) {
  arduboy.drawBitmap(41,56,waterdippedfeet,18,8,WHITE);
	}
	if (waterfallframe==3) {
  arduboy.drawBitmap(41,56,waterdippedfeet,18,8,WHITE);
	}
	if (waterfallframe==4) {
  arduboy.drawBitmap(40,56,waterdippedfeet,18,8,WHITE);
	}
	if (waterfallframe==5) {
  arduboy.drawBitmap(40,56,waterdippedfeet,18,8,WHITE);
	}
	if (waterfallframe>=6) {
  arduboy.drawBitmap(39,56,waterdippedfeet,18,8,WHITE);
	}
	if (waterwaveframe<=31) {
	  arduboy.drawBitmap(27,13,eye0,5,8,BLACK);
	}
	if (waterwaveframe>=32) {
	  arduboy.drawBitmap(27,13,eye0_closed,5,8,BLACK);
	}
	arduboy.drawBitmap(44-waterwaveframe,56,waterwave_big,128,8,WHITE);
	if (waterfallframe>8) {
		waterfallframe = 0;
	}
	if (waterwaveframe>32) {
		waterwaveframe = 0;
	}
	arduboy.drawBitmap(104,0,signature,24,16,WHITE);
}
#endif